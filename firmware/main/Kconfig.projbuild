## firmware/main/Kconfig.projbuild
```kconfig
menu "T3"

    config T3_DEBUG_SERIAL
        bool "Serial debug channel (SHOT, KEY, HEAP, DROP on the USB console)"
        default y
        help
            Compiles and starts the debug channel. Release builds turn it off.

    config T3_KEYBOARD_TRACE
        bool "Log the raw keyboard event code of every key (records typed passwords by matrix position)"
        default n
        help
            For checking the key map on a physical keyboard at a checkpoint. Never leave it on: the log shows what is typed, passwords included.

endmenu
```
